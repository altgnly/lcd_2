	LIST P=16F877A
	#INCLUDE <P16F877A.INC>
	SAYICI1 EQU 0X20
	SAYICI2 EQU 0X21
	LCD_DEGER EQU 0X22
	ORG 0X00
	GOTO ANA_METOT

ANA_METOT
	BANKSEL TRISB
	CLRF TRISB
	BANKSEL PORTB
	CLRF PORTB

	CALL LCD_AYARLAMA
	CALL KARAKTERLER

LCD_AYARLAMA
	MOVLW H'02'
	CALL LCD_KOMUT_YAZ

	MOVLW H'0C'
	CALL LCD_KOMUT_YAZ

	MOVLW H'28'
	CALL LCD_KOMUT_YAZ

	RETURN

SATIR2
	MOVLW H'C0'
	CALL LCD_KOMUT_YAZ

	RETURN

LCD_VERI_YAZ
	MOVWF LCD_DEGER
	SWAPF LCD_DEGER,W
	CALL LCD_VERI_GONDER
	MOVF LCD_DEGER,W
	CALL LCD_VERI_GONDER
	RETURN

LCD_VERI_GONDER
	ANDLW 0X0F
	MOVWF PORTB
	
	BSF PORTB,4
	
	BSF PORTB,6
	CALL GECIKME	
	BCF PORTB,6
	RETURN

LCD_KOMUT_YAZ
	MOVWF LCD_DEGER
	SWAPF LCD_DEGER,W
	CALL LCD_KOMUT_GONDER
	MOVF LCD_DEGER,W
	CALL LCD_KOMUT_GONDER
	RETURN

LCD_KOMUT_GONDER
	ANDLW 0X0F
	MOVWF PORTB

	BCF PORTB,4
	
	BSF PORTB,6
	CALL GECIKME
	BCF PORTB,6
	RETURN

GECIKME
	MOVLW 0XFF
	MOVWF SAYICI1

TEKRAR1
	MOVLW 0XFF
	MOVWF SAYICI2

TEKRAR2
	DECFSZ SAYICI2,F
	GOTO TEKRAR2
	DECFSZ SAYICI1,F
	GOTO TEKRAR1
	RETURN

KARAKTERLER
	MOVLW A'N'
	CALL LCD_VERI_YAZ
	
	MOVLW A'I'
	CALL LCD_VERI_YAZ

	MOVLW A'L'
	CALL LCD_VERI_YAZ

	MOVLW A'A'
	CALL LCD_VERI_YAZ

	MOVLW A'Y'
	CALL LCD_VERI_YAZ

	CALL SATIR2

	MOVLW A'N'
	CALL LCD_VERI_YAZ
	
	MOVLW A'I'
	CALL LCD_VERI_YAZ

	MOVLW A'L'
	CALL LCD_VERI_YAZ

	MOVLW A'A'
	CALL LCD_VERI_YAZ

	MOVLW A'Y'
	CALL LCD_VERI_YAZ

	RETURN

END